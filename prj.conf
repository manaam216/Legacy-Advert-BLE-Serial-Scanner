## CMakeLists.txt
```
cmake_minimum_required(VERSION 3.20.0)
find_package(Zephyr REQUIRED HINTS $ENV{ZEPHYR_BASE})

project(legacy_ble_serial_scanner)

add_subdirectory(components/crc_compute)

target_include_directories(app PRIVATE ${CMAKE_CURRENT_SOURCE_DIR}/include)

target_sources(app PRIVATE
    src/main.c
    src/scanner.c
    src/worker.c
    src/crypto_util.c
    src/packet.c
)
```

## west.yml
```
manifest:
  # Your project is the main application
  self:
    path: legacy_ble_serial_scanner

  # External dependencies (Zephyr + NCS modules)
  remotes:
    - name: nordic
      url-base: https://github.com/nrfconnect

  projects:

    # nRF Connect SDK base (includes Zephyr fork and Nordic libraries)
    - name: sdk-nrf
      remote: nordic
      revision: main
      path: nrf
      import: true
```

## prj.conf
```kconfig
# -----------------
# Bluetooth Scanning
# -----------------
CONFIG_BT=y
CONFIG_BT_OBSERVER=y
CONFIG_BT_SCAN=y
CONFIG_BT_DEVICE_NAME="WePowerScanner"
CONFIG_BT_DEVICE_APPEARANCE=0

# -----------------
# Logging / UART
# -----------------
CONFIG_PRINTK=y
CONFIG_LOG=y


# -----------------
# Crypto (AES-ECB)
# -----------------
CONFIG_HW_CC3XX=n
CONFIG_ENTROPY_CC3XX=n
CONFIG_ENTROPY_NRF5_RNG=y
CONFIG_CC3XX_BACKEND=n
# Software Crypto with Mbed
CONFIG_MBEDTLS=y
CONFIG_MBEDTLS_BUILTIN=y
CONFIG_MBEDTLS_HEAP_SIZE=512
CONFIG_MBEDTLS_CIPHER_CCM_ENABLED=y
CONFIG_MBEDTLS_CIPHER_GCM_ENABLED=y
CONFIG_CRYPTO=y
CONFIG_CRYPTO_MBEDTLS_SHIM=y


# -----------------
# Power / Optimizations
# -----------------
CONFIG_MAIN_STACK_SIZE=16384
CONFIG_HEAP_MEM_POOL_SIZE=6144

CONFIG_CRC=y
```

## nrf52840dk_nrf52840.overlay
```dts
	/ {
        chosen {
            zephyr,entropy = &rng;
        };
    };
```

## src/main.c
```c
#include <zephyr/kernel.h>
#include <zephyr/sys/printk.h>
#include "scanner.h"
#include "worker.h"

int main(void)
{
    printk("Starting BLE scanner (modularized)...\n");

    start_worker();

    if (scanner_start() != 0) {
        printk("Scanner failed\n");
    }

    return 0;
}
```

## include/crypto_util.h
```c
#ifndef CRYPTO_UTIL_H
#define CRYPTO_UTIL_H

#include <stddef.h>
#include <stdint.h>

int decrypt_payload(uint8_t *input, size_t len, uint8_t *output);

#endif /* CRYPTO_UTIL_H */
```

## include/packet.h
```c
#ifndef PACKET_H
#define PACKET_H

#include <stdint.h>

#define PAYLOAD_FRAME_LENGTH 20
#define ENCRYPTED_DATA_SIZE_BYTES   16
#define EVENT_COUNTER_NUM_BYTES     3
#define SRC_ID_NUM_BYTES            3
#define SENSOR_TYPE_NUM_BYTES       2
#define PAYLOAD_MAX_NUM_BYTES       10
#define NETWORK_ID_NUM_BYTES        2

typedef enum
{
	EVENT_TYPE_BUTTON_PRESS = 0,
	EVENT_TYPE_VIBRATION,
	EVENT_TYPE_BUTTON_ON,
	EVENT_TYPE_BUTTON_OFF,
	EVENT_TYPE_LEAK_DETECTED,
	EVENT_TYPE_EXTERNAL_POWER = 255,
}event_type_t;


typedef union {
    struct 
    {
        uint8_t src_id[SRC_ID_NUM_BYTES];
        uint8_t nwk_id[NETWORK_ID_NUM_BYTES];
        uint8_t sensor_type;
        uint8_t payload[PAYLOAD_MAX_NUM_BYTES];
    } fields;
    uint8_t data_bytes[ENCRYPTED_DATA_SIZE_BYTES];
} ble_pkt_encrypted_data_t;

typedef union 
{
    struct {
        uint8_t encrypt_status      : 1;
        uint8_t self_external_power : 1; 
        uint8_t event_counter_lsb   : 2; 
        uint8_t payload_length      : 4; 
    } bits;
    uint8_t raw; // direct access to full byte
} ble_packet_flags_t;
void print_decoded_packet(const ble_pkt_encrypted_data_t *pkt,
                          const ble_packet_flags_t *flags);

#endif /* PACKET_H */
```

## include/scanner.h
```c
#ifndef SCANNER_H
#define SCANNER_H

#include <zephyr/bluetooth/bluetooth.h>
#include <zephyr/bluetooth/hci.h>

/* Initialize and start BLE scanning */
int scanner_start(void);

#endif /* SCANNER_H */
```

## include/worker.h
```c
#ifndef WORKER_H
#define WORKER_H

#include <zephyr/bluetooth/bluetooth.h>

#define ENCRYPTED_DATA_SIZE_BYTES   16

struct decrypt_job {
    uint8_t encrypted[ENCRYPTED_DATA_SIZE_BYTES];
    uint8_t flags_raw;
    int8_t rssi;
    bt_addr_le_t addr;
};

/* API */
int enqueue_job(const struct decrypt_job *job);
void start_worker(void);

#endif /* WORKER_H */
```

## src/crypto_util.c
```c
#include <zephyr/device.h>
#include <zephyr/crypto/crypto.h>
#include <zephyr/sys/printk.h>
#include "crypto_util.h"

#define AES_KEY_SIZE 16

static uint8_t ecb_key[AES_KEY_SIZE] = {
    0x00,0x01,0x02,0x03,
    0x04,0x05,0x06,0x07,
    0x08,0x09,0x0A,0x0B,
    0x0C,0x0D,0x0E,0x0F
};

int decrypt_payload(uint8_t *input, size_t len, uint8_t *output)
{
    const struct device *dev_crypto =
        device_get_binding(CONFIG_CRYPTO_MBEDTLS_SHIM_DRV_NAME);
    if (!dev_crypto || !device_is_ready(dev_crypto)) {
        printk("Crypto device not ready\n");
        return -1;
    }

    struct cipher_ctx ctx = {0};
    ctx.keylen = AES_KEY_SIZE;
    ctx.key.bit_stream = ecb_key;

    if (cipher_begin_session(dev_crypto, &ctx,
                             CRYPTO_CIPHER_ALGO_AES,
                             CRYPTO_CIPHER_MODE_ECB,
                             CRYPTO_CIPHER_OP_DECRYPT)) {
        printk("Failed to start AES-ECB session\n");
        return -1;
    }

    struct cipher_pkt pkt = {
        .in_buf = input,
        .in_len = len,
        .out_buf = output,
        .out_buf_max = len,
    };

    int ret = cipher_block_op(&ctx, &pkt);
    cipher_free_session(dev_crypto, &ctx);

    return ret ? -1 : pkt.out_len;
}
```

## src/packet.c
```c
#include <zephyr/sys/printk.h>
#include <stdint.h>
#include <string.h>

#include "packet.h"

void print_decoded_packet(const ble_pkt_encrypted_data_t *pkt,
                          const ble_packet_flags_t *flags)
{
    if (!pkt || !flags) {
        printk("ERR: NULL packet\n");
        return;
    }

    printk("SRC ID: %02X%02X%02X\n",
           pkt->fields.src_id[2],
           pkt->fields.src_id[1],
           pkt->fields.src_id[0]);

    printk("NWK ID: %02X%02X\n",
           pkt->fields.nwk_id[1],
           pkt->fields.nwk_id[0]);

    printk("Sensor Type: 0x%02X\n", pkt->fields.sensor_type);

    printk("Flags: raw=%02X enc=%u ext=%u ec_lsb=%u pl_len=%u\n",
           flags->raw,
           flags->bits.encrypt_status,
           flags->bits.self_external_power,
           flags->bits.event_counter_lsb,
           flags->bits.payload_length);

    /* NEW PACKET FORMAT */
    const uint8_t *p = pkt->fields.payload;

    uint32_t event_counter = ((uint32_t)p[0]) |
                             ((uint32_t)p[1] << 8) |
                             ((uint32_t)p[2] << 16);

    uint8_t event_type = p[3];

    printk("Event Counter: %u\n", event_counter);
    printk("Event Type: %u\n", event_type);

    /* 4–9 bytes = type-specific payload */
    switch (event_type)
    {
        /* TYPE 0 (BUTTON_PRESS) and TYPE 3 (POLARITY)—both carry accelerometer */
        case EVENT_TYPE_BUTTON_PRESS:
        case EVENT_TYPE_BUTTON_ON:
        case EVENT_TYPE_BUTTON_OFF:
        {
            int16_t ax = (int16_t)((uint16_t)p[4] | ((uint16_t)p[5] << 8));
            int16_t ay = (int16_t)((uint16_t)p[6] | ((uint16_t)p[7] << 8));
            int16_t az = (int16_t)((uint16_t)p[8] | ((uint16_t)p[9] << 8));

            printk("Accel: X=%d Y=%d Z=%d\n", ax, ay, az);
            break;
        }

        /* TYPE 2 (VIBRATION) — random/sample bytes */
        case EVENT_TYPE_VIBRATION:
        case EVENT_TYPE_LEAK_DETECTED:
        {
            printk("Sample Bytes: %02X %02X %02X %02X %02X %02X\n",
                    p[4], p[5], p[6], p[7], p[8], p[9]);
            break;
        }

        case EVENT_TYPE_EXTERNAL_POWER:
            printk("External Power Event\n");
            break;

        default:
            printk("Unknown Event Type: %u\n", event_type);
            break;
    }
}
```

## src/scanner.c
```c
#include <zephyr/kernel.h>
#include <zephyr/logging/log.h>
#include <zephyr/bluetooth/bluetooth.h>
#include <zephyr/bluetooth/hci.h>
#include <zephyr/net_buf.h>
#include <zephyr/sys/printk.h>
#include <string.h>

#include "scanner.h"

LOG_MODULE_REGISTER(scanner, LOG_LEVEL_INF);

static void device_found(const bt_addr_le_t *addr,
                         int8_t rssi,
                         uint8_t adv_type,
                         struct net_buf_simple *ad)
{
    char name[32] = {0};
    const uint8_t *mfg = NULL;
    uint8_t mfg_len = 0;

    ARG_UNUSED(adv_type);

    while (ad->len > 1U) {
        uint8_t len = net_buf_simple_pull_u8(ad);

        if (len == 0U || ad->len < len) {
            break;
        }

        uint8_t type = net_buf_simple_pull_u8(ad);
        uint8_t data_len = len - 1U;
        uint8_t *data = ad->data;

        if ((type == BT_DATA_NAME_COMPLETE || type == BT_DATA_NAME_SHORTENED) &&
            data_len > 0U) {
            uint8_t copy_len = (data_len < sizeof(name) - 1U) ? data_len : (sizeof(name) - 1U);
            memcpy(name, data, copy_len);
            name[copy_len] = '\0';
        } else if (type == BT_DATA_MANUFACTURER_DATA) {
            mfg = data;
            mfg_len = data_len;
        }

        net_buf_simple_pull(ad, data_len);
    }



    if (mfg && mfg_len) {
        for (uint8_t i = 0; i < mfg_len; i++) {
            printk("%02X", mfg[i]);
        }
    } else {
        printk("N/A");
    }

    printk("\n");
}

int scanner_start(void)
{
    int err = bt_enable(NULL);
    if (err) {
        LOG_ERR("Bluetooth init failed (err %d)", err);
        return err;
    }

    static const struct bt_le_scan_param scan_param = {
        .type     = BT_LE_SCAN_TYPE_PASSIVE,
        .options  = BT_LE_SCAN_OPT_NONE,
        .interval = 0x0010,
        .window   = 0x0010,
    };

    err = bt_le_scan_start(&scan_param, device_found);
    if (err) {
        LOG_ERR("Scanning start failed (err %d)", err);
        return err;
    }

    printk("Scanning started\n");
    return 0;
}
```

## src/worker.c
```c
#include <zephyr/kernel.h>
#include <zephyr/sys/printk.h>
#include <zephyr/bluetooth/bluetooth.h>
#include <string.h>
#include "worker.h"
#include "crypto_util.h"
#include "packet.h"

#define MAX_JOBS 300
K_MSGQ_DEFINE(decrypt_msgq, sizeof(struct decrypt_job), MAX_JOBS, 4);



static void decrypt_worker(void *a, void *b, void *c)
{
    ARG_UNUSED(a); ARG_UNUSED(b); ARG_UNUSED(c);

    struct decrypt_job job;
    uint8_t decrypted[ENCRYPTED_DATA_SIZE_BYTES];

    while (1) {
        if (k_msgq_get(&decrypt_msgq, &job, K_FOREVER) == 0) {
            ble_packet_flags_t flags = {.raw = job.flags_raw};

            int dec_len = -1;
            if (flags.bits.encrypt_status == 0) {
                dec_len = decrypt_payload(job.encrypted, ENCRYPTED_DATA_SIZE_BYTES, decrypted);
            } else {
                memcpy(decrypted, job.encrypted, ENCRYPTED_DATA_SIZE_BYTES);
                dec_len = ENCRYPTED_DATA_SIZE_BYTES;
            }

            char addr_str[BT_ADDR_LE_STR_LEN];
            bt_addr_le_to_str(&job.addr, addr_str, sizeof(addr_str));

            if (dec_len == ENCRYPTED_DATA_SIZE_BYTES) {
                ble_pkt_encrypted_data_t packet;
                memcpy(packet.data_bytes, decrypted, ENCRYPTED_DATA_SIZE_BYTES);
                print_decoded_packet(&packet, &flags);

            } else {
                printk("Decryption failed (addr %s, rssi %d)\n", addr_str, job.rssi);
            }
        }
    }
}

int enqueue_job(const struct decrypt_job *job)
{
    return k_msgq_put(&decrypt_msgq, job, K_NO_WAIT);
}

K_THREAD_DEFINE(decrypt_tid, 4096, decrypt_worker, NULL, NULL, NULL,
                        5, 0, 0);

void start_worker(void)
{

}
```
